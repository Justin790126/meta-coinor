## conf/layer.conf
```bitbake
# We have a conf and classes directory, add to BBPATH
BBPATH .= ":${LAYERDIR}"

# We have recipes-* directories, add to BBFILES
BBFILES += "${LAYERDIR}/recipes-*/*/*.bb \
            ${LAYERDIR}/recipes-*/*/*.bbappend"

BBFILE_COLLECTIONS += "meta-coinor"
BBFILE_PATTERN_meta-coinor = "^${LAYERDIR}/"
BBFILE_PRIORITY_meta-coinor = "6"

LAYERDEPENDS_meta-coinor = "core"
LAYERSERIES_COMPAT_meta-coinor = "dunfell"


COINUTILS_GIT_V = "2.10.14"
OSI_GIT_V = "0.107.9"
CLP_GIT_V = "1.16.11"
CGL_GIT_V = "0.59.10"

COINUTILS_V = "${COINUTILS_GIT_V}-r0"
OSI_V = "${OSI_GIT_V}-r0"
CLP_V = "${CLP_GIT_V}-r0"
CGL_V = "${CGL_GIT_V}-r0"


CROSS_SYSROOT="${TMPDIR}/work/${TARGET_SYS}"
```
